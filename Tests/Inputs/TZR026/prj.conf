## CMakeLists.txt
```
cmake_minimum_required(VERSION 3.20.0)
find_package(Zephyr REQUIRED HINTS $ENV{ZEPHYR_BASE})
project(test_execution_time_measurement)
target_sources(app PRIVATE src/main.c)
```

## prj.conf
```kconfig
CONFIG_THREAD_MONITOR=y
CONFIG_THREAD_RUNTIME_STATS=y
CONFIG_TIMESLICING=y
CONFIG_SCHED_THREAD_USAGE=y
CONFIG_THREAD_ANALYZER=y
CONFIG_TIMING_FUNCTIONS=y
```

## nucleo_f401re.overlay
```dts
&tim2 {
    status = "okay";
    interrupts = <28 0>;  // Correct: 2 values for 2 interrupt-cells
};
```

## src/main.c
```c
#include <zephyr/kernel.h>
#include <zephyr/sys/printk.h>
#include <zephyr/arch/cpu.h>  // For cycle counting functions

void main(void) {
    printk("Starting execution time measurement...\n");

    // Read the start cycle count
    uint32_t start_cycles = k_cycle_get_32();

    // Code block to measure
    for (volatile int i = 0; i < 100000; i++) {
        // Simulated workload
    }

    // Read the end cycle count
    uint32_t end_cycles = k_cycle_get_32();

    // Calculate elapsed cycles
    uint32_t elapsed_cycles = end_cycles - start_cycles;

    // Convert cycles to nanoseconds
    uint64_t elapsed_ns = k_cyc_to_ns_floor64(elapsed_cycles);

    printk("Elapsed cycles: %u\n", elapsed_cycles);
    printk("Elapsed time: %llu ns\n", elapsed_ns);
}
```
